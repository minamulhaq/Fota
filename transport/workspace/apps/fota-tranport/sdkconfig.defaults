## transport/workspace/components/fota/Kconfig
```kconfig
# FOTA Kconfig
config FOTA
    bool "ESP Transport layer for FOTA"
    default n
    help
        Add Fota transport layer to communicate with Nucleo board via uart.
```
